## CMakeLists.txt
```
cmake_minimum_required(VERSION 3.20.0)

find_package(Zephyr REQUIRED HINTS $ENV{ZEPHYR_BASE})
project(6sens_rtos_rtc)

FILE(GLOB app_sources src/*.c)
target_sources(app PRIVATE ${app_sources})
```

## prj.conf
```kconfig
# Debugger Support
CONFIG_CONSOLE=y
CONFIG_SERIAL=y
CONFIG_UART_CONSOLE=n

# RTT Segger Support
CONFIG_RTT_CONSOLE=y
CONFIG_USE_SEGGER_RTT=y

# Communication Bus Support
CONFIG_GPIO=y
CONFIG_SPI=y
CONFIG_I2C=y

# RTC Support
CONFIG_COUNTER=y
CONFIG_COUNTER_MAXIM_DS3231=y
CONFIG_POSIX_API=y
CONFIG_NEWLIB_LIBC=y
```

## src/main.c
```c
/*
 * Copyright (c) 2025
 * Regis Rousseau
 * Univ Lyon, INSA Lyon, Inria, CITI, EA3720
 * SPDX-License-Identifier: Apache-2.0
 */

//  ========== includes ====================================================================

#include "app_ds3231.h"
#include <zephyr/kernel.h>
#include <zephyr/drivers/counter.h>   
#include <zephyr/drivers/i2c.h>    
#include <zephyr/device.h>            
#include <zephyr/devicetree.h>        
#include <zephyr/posix/time.h>         
#include <zephyr/sys/timeutil.h>

//  ========== defines =====================================================================
#define STACK_SIZE 2048
#define PRIORITY   2

//  ========== globals =====================================================================
K_SEM_DEFINE(init_done_sem, 0, 1);

//  ========== interrupt sub-routine =======================================================
void rtc_thread_func(void)
{
	k_sem_take(&init_done_sem, K_FOREVER);
    const struct device *ds3231_dev = DEVICE_DT_GET_ONE(maxim_ds3231);

    while (true) {
        app_ds3231_periodic_sync(ds3231_dev);   // re-anchor offset
        k_sleep(K_SECONDS(30));
    }	
}
K_THREAD_DEFINE(rtc_thread_id, STACK_SIZE, rtc_thread_func, NULL, NULL, NULL, PRIORITY, 0, 0);

void rtc_work_handler(struct k_work *work_rtc)
{
	uint64_t ts = app_get_timestamp();
    printk("timestamp (ms): %llu\n", ts);
}
K_WORK_DEFINE(rtc_work, rtc_work_handler);

void rtc_timer_handler(struct k_timer *rtc_dum)
{
	k_work_submit(&rtc_work);
}
K_TIMER_DEFINE(rtc_timer, rtc_timer_handler, NULL);

// ========== main =========================================================================
int8_t main(void)
{
	// init and set DS3231 once at boot
    const struct device *ds3231_dev = app_ds3231_init();
    if (!ds3231_dev) {
        printk("failed to initialize DS3231\n");
        return 0;
    }
    app_ds3231_set_time(ds3231_dev, 1773741600);

    // start nRF internal RTC counter
    const struct device *nrf_rtc = DEVICE_DT_GET(DT_NODELABEL(rtc2));
    counter_start(nrf_rtc);

    printk("RTC system ready\n");

    k_sem_give(&init_done_sem);
    k_timer_start(&rtc_timer, K_SECONDS(5), K_SECONDS(10));
    return 0;
}
```

## src/app_ds3231.c
```c
/*
 * Copyright (c) 2025
 * Regis Rousseau
 * Univ Lyon, INSA Lyon, Inria, CITI, EA3720
 * SPDX-License-Identifier: Apache-2.0
 */

//  ========== includes ===================================================================
#include "app_ds3231.h"

//  ========== globals ====================================================================
static int64_t  rtc_offset_ms = 0;   // anchors nRF ticks to DS3231 unix time
static struct k_mutex offset_mutex;

//  ========== bin_to_bcd ==================================================================
static uint8_t bcd_to_bin(uint8_t val)
{
    return ((val >> 4) * 10) + (val & 0x0f);
}

//  ========== bin_to_bcd ==================================================================
static uint8_t bin_to_bcd(uint8_t val)
{
    return ((val / 10) << 4) | (val % 10);
}

//  ========== ds3231_read_unix ============================================================
// reads DS3231 registers directly via I2C, bypassing counter_get_value
static int ds3231_read_unix(uint32_t *unix_secs)
{
    const struct device *i2c = DEVICE_DT_GET(DT_NODELABEL(i2c0));
    if (!device_is_ready(i2c)) {
        return -ENODEV;
    }

    uint8_t reg = DS3231_REG_TIME;
    uint8_t buf[7];

    int ret = i2c_write_read(i2c, DS3231_I2C_ADDR, &reg, 1, buf, 7);
    if (ret < 0) {
        printk("DS3231 i2c read failed: %d\n", ret);
        return ret;
    }

    // convert registers to struct tm
    struct tm utc = {
        .tm_sec  = bcd_to_bin(buf[0] & 0x7f),
        .tm_min  = bcd_to_bin(buf[1] & 0x7f),
        .tm_hour = bcd_to_bin(buf[2] & 0x3f),
        .tm_mday = bcd_to_bin(buf[4] & 0x3f),
        .tm_mon  = bcd_to_bin(buf[5] & 0x1f) - 1,
        .tm_year = bcd_to_bin(buf[6]) + 100,
    };

    // convert to unix seconds
    *unix_secs = (uint32_t)timeutil_timegm64(&utc);

    printk("DS3231 direct read: %02d:%02d:%02d %02d/%02d/%04d -> unix=%u\n",
           utc.tm_hour, utc.tm_min, utc.tm_sec,
           utc.tm_mday, utc.tm_mon + 1, utc.tm_year + 1900,
           *unix_secs);

    return 0;
}

//  ========== app_ds3231_init =============================================================
const struct device *app_ds3231_init(void)
{
    //const struct device *dev = DEVICE_DT_GET_ONE(maxim_ds3231);
    const struct device *dev = DEVICE_DT_GET(DT_NODELABEL(i2c0));
    if (!device_is_ready(dev)) {   // ← correct check
        printk("DS3231 not ready\n");
        return NULL;
    }

    k_mutex_init(&offset_mutex);
    printk("DS3231 ready\n");
    return dev;
}

//  ========== app_ds3231_set_time =========================================================
int8_t app_ds3231_set_time(const struct device *ds3231_dev, uint32_t unix_secs)
{
    if (!device_is_ready(ds3231_dev)) {
        return -ENODEV;
    }

    const struct device *i2c = DEVICE_DT_GET(DT_NODELABEL(i2c0));
    if (!device_is_ready(i2c)) {
        printk("I2C bus not ready\n");
        return -ENODEV;
    }

    struct tm utc;
    time_t t = (time_t)unix_secs;
    gmtime_r(&t, &utc);

    uint8_t buf[8];
    buf[0] = DS3231_REG_TIME;
    buf[1] = bin_to_bcd(utc.tm_sec);
    buf[2] = bin_to_bcd(utc.tm_min);
    buf[3] = bin_to_bcd(utc.tm_hour);
    buf[4] = bin_to_bcd(utc.tm_wday + 1);
    buf[5] = bin_to_bcd(utc.tm_mday);
    buf[6] = bin_to_bcd(utc.tm_mon + 1);
    buf[7] = bin_to_bcd(utc.tm_year - 100);

    int ret = i2c_write(i2c, buf, sizeof(buf), DS3231_I2C_ADDR);
    if (ret < 0) {
        printk("i2c_write failed: %d\n", ret);
        return ret;
    }

    k_sleep(K_MSEC(1100));

    // read back directly via I2C, NOT counter_get_value
    uint32_t readback;
    ret = ds3231_read_unix(&readback);
    if (ret < 0) {
        return ret;
    }

    int64_t uptime_ms = k_uptime_get();
    int64_t target_ms = (int64_t)readback * 1000;

    k_mutex_lock(&offset_mutex, K_FOREVER);
    rtc_offset_ms = target_ms - uptime_ms;
    k_mutex_unlock(&offset_mutex);

    printk("DS3231 time set to unix=%u, offset=%lld ms\n",
           readback, rtc_offset_ms);
    return 0;
}

//  ========== app_ds3231_periodic_sync ====================================================
int8_t app_ds3231_periodic_sync(const struct device *ds3231_dev)
{
    uint32_t unix_secs;
    int ret = ds3231_read_unix(&unix_secs);   // direct I2C, not counter_get_value
    if (ret < 0) {
        printk("DS3231 periodic sync failed: %d\n", ret);
        return ret;
    }

    const struct device *nrf_rtc = DEVICE_DT_GET(DT_NODELABEL(rtc2));
    uint32_t ticks;
    counter_get_value(nrf_rtc, &ticks);
    uint32_t freq   = counter_get_frequency(nrf_rtc);
    int64_t tick_ms = ((int64_t)ticks * 1000) / freq;

    int64_t new_offset = (int64_t)unix_secs * 1000 - tick_ms;

    k_mutex_lock(&offset_mutex, K_FOREVER);
    rtc_offset_ms = new_offset;
    k_mutex_unlock(&offset_mutex);

    printk("sync: DS3231=%u s, tick_ms=%lld ms, offset=%lld ms\n",
           unix_secs, tick_ms, new_offset);
    return 0;
}

//  ========== app_get_timestamp ===========================================================
// returns unix timestamp in ms with sub-second precision from nRF RTC ticks
uint64_t app_get_timestamp(void)
{
    const struct device *nrf_rtc = DEVICE_DT_GET(DT_NODELABEL(rtc2));
    uint32_t ticks;
    counter_get_value(nrf_rtc, &ticks);
    uint32_t freq   = counter_get_frequency(nrf_rtc);
    int64_t tick_ms = ((int64_t)ticks * 1000) / freq;

    int64_t offset;
    k_mutex_lock(&offset_mutex, K_FOREVER);
    offset = rtc_offset_ms;
    k_mutex_unlock(&offset_mutex);

    int64_t result = tick_ms + offset;
    if (result < 0) {
        return 0;
    }
    return (uint64_t)result;
}
```

## src/app_ds3231.h
```c
/*
 * Copyright (c) 2025
 * Regis Rousseau
 * Univ Lyon, INSA Lyon, Inria, CITI, EA3720
 * SPDX-License-Identifier: Apache-2.0
 */

#ifndef APP_DS3231_H
#define APP_DS3231_H

//  ========== includes ====================================================================
#include <zephyr/kernel.h>
#include <zephyr/device.h>
#include <zephyr/devicetree.h>
#include <zephyr/drivers/counter.h>
#include <zephyr/drivers/i2c.h>
#include <zephyr/posix/time.h>

//  ========== defines =====================================================================
#define DS3231_I2C_ADDR     0x68
#define DS3231_REG_TIME     0x00

//  ========== prototypes ==================================================================
const struct device *app_ds3231_init(void);
int8_t app_ds3231_set_time(const struct device *ds3231_dev, uint32_t unix_secs);
int8_t app_ds3231_periodic_sync(const struct device *ds3231_dev);
uint64_t app_get_timestamp(void);

#endif /* APP_DS3231_H */
```

## src/app_rtc.c
```c
/*
 * Copyright (c) 2025
 * Regis Rousseau
 * Univ Lyon, INSA Lyon, Inria, CITI, EA3720
 * SPDX-License-Identifier: Apache-2.0
 */

//  ========== includes ====================================================================
#include "app_rtc.h"

//  ========== globals =====================================================================
// global variable to track the offset between the system clock and RTC
static int64_t system_rtc_offset_ms = 0;
static struct k_mutex offset_mutex;

//  ========== app_rtc_init ================================================================
const struct device *app_rtc_init(void)
{
    const struct device *rtc_dev = DEVICE_DT_GET(DT_NODELABEL(rtc0));
    if (!device_is_ready(rtc_dev)) {
        printk("RTC device is not ready\n");
        return NULL;
    }

    // start the counter
    int8_t ret = counter_start(rtc_dev);
    if (ret < 0) {
        printk("failed to start RTC: %d\n", ret);
        return NULL;
    }

    // initialize mutex
    k_mutex_init(&offset_mutex);

    printk("RTC initialized and started successfully (device: %s)\n", rtc_dev->name);
    return rtc_dev;
}

//  ========== app_rtc_set_time ============================================================
int8_t app_rtc_set_time(const struct device *rtc_dev, uint64_t target_time_ms)
{
    if (!rtc_dev) {
        printk("RTC device is NULL\n");
        return -EINVAL;
    }

    uint32_t rtc_ticks;
    int8_t ret = counter_get_value(rtc_dev, &rtc_ticks);
    if (ret < 0) {
        printk("failed to read RTC ticks: %d\n", ret);
        return ret;
    }

    uint32_t frequency = counter_get_frequency(rtc_dev);
    int64_t rtc_time_ms = ((int64_t)rtc_ticks * 1000) / frequency;

    int64_t new_offset = (int64_t)target_time_ms - rtc_time_ms;

    // safely update the global offset
    k_mutex_lock(&offset_mutex, K_FOREVER);
    system_rtc_offset_ms = new_offset;
    k_mutex_unlock(&offset_mutex);

    printk("RTC time logically set to %llu ms via offset (%lld ms)\n", target_time_ms, new_offset);
    return 0;
}

//  ========== app_rtc_sync_uptime =========================================================
// synchronize the system uptime with the on-board RTC.
int8_t app_rtc_sync_uptime(const struct device *rtc_dev)
{
    if (!rtc_dev) {
        printk("RTC device is NULL\n");
        return -EINVAL;
    }

    uint32_t rtc_ticks;
    uint32_t top_value;
    uint32_t frequency;
    int64_t rtc_time_ms;
    int64_t current_uptime_ms;
    int64_t new_offset_ms;

    // get system cycle count before and after RTC read
    uint64_t t1_cycles = k_cycle_get_64();

    // retrieve the current RTC counter value
    int8_t ret = counter_get_value(rtc_dev, &rtc_ticks);
    if (ret < 0) {
        printk("failed to get RTC counter value, error: %d\n", ret);
        return ret;
    }

    uint64_t t2_cycles = k_cycle_get_64();

    // compute midpoint cycle time and convert to milliseconds
    uint64_t mid_cycles = (t1_cycles + t2_cycles) / 2;
    uint64_t sys_clk_hz = sys_clock_hw_cycles_per_sec();
    current_uptime_ms = (mid_cycles * 1000) / sys_clk_hz;

    // get the counter's top value and frequency
    top_value = counter_get_top_value(rtc_dev);
    frequency = counter_get_frequency(rtc_dev);

    // convert the RTC ticks to milliseconds
    rtc_time_ms = ((int64_t)rtc_ticks * 1000) / frequency;

    // debug output
    printk("RTC ticks: %u, top: %u, freq: %u Hz, time_ms: %lld\n",
           rtc_ticks, top_value, frequency, rtc_time_ms);

    // calculate the offset between RTC time and system uptime
    new_offset_ms = rtc_time_ms - current_uptime_ms;

    // validate the offset (example: restrict offset to ±1 year for sanity)
    if (new_offset_ms < -ONE_YEAR_MS || new_offset_ms > ONE_YEAR_MS) {
        printk("offset out of range! calculation error\n");
        return -EINVAL;
    }

    // safely update the global offset
    k_mutex_lock(&offset_mutex, K_FOREVER);
    system_rtc_offset_ms = new_offset_ms;
    k_mutex_unlock(&offset_mutex);

    // debugging output
    printk("calculated offset (ms): %lld\n", system_rtc_offset_ms);

    return 0;
}

//  ========== app_rtc_get_time ============================================================
uint64_t app_rtc_get_time()
{
    int64_t current_uptime_ms = k_uptime_get();
    int64_t offset_ms;

    // safely read the offset
    k_mutex_lock(&offset_mutex, K_FOREVER);
    offset_ms = system_rtc_offset_ms;
    k_mutex_unlock(&offset_mutex);

    // check for overflow or underflow
    if (offset_ms > 0 &&
        current_uptime_ms > UINT64_MAX - offset_ms) {
        printk("overflow detected in timestamp calculation\n");
        return UINT64_MAX;
    }
    if (offset_ms < 0 &&
        current_uptime_ms < (uint64_t)(-offset_ms)) {
        printk("underflow detected in timestamp calculation\n");
        return 0;
    }
    uint64_t timestamp_ms = current_uptime_ms + offset_ms;
    return timestamp_ms;
}

//  ========== app_rtc_periodic_sync========================================================
int8_t app_rtc_periodic_sync(const struct device *rtc_dev)
{
    if (!rtc_dev) {
        printk("RTC device is NULL\n");
        return -EINVAL;
    }
    
    // call this periodically from a thread or workqueue
    int8_t ret = app_rtc_sync_uptime(rtc_dev);
    if (ret < 0) {
        printk("periodic sync failed, error: %d\n", ret);
    }
    return 0;
}
```

## src/app_rtc.h
```c
/*
 * Copyright (c) 2025
 * Regis Rousseau
 * Univ Lyon, INSA Lyon, Inria, CITI, EA3720
 * SPDX-License-Identifier: Apache-2.0
 */

#ifndef APP_RTC_H
#define APP_RTC_H

//  ========== includes ====================================================================
#include <zephyr/kernel.h>
#include <zephyr/device.h>
#include <zephyr/devicetree.h>
#include <zephyr/drivers/rtc.h>
#include <zephyr/drivers/counter.h>
#include <zephyr/sys_clock.h> 

//  ========== defines =====================================================================
#define ONE_YEAR_MS                 365LL * 24 * 60 * 60 * 1000
#define CONFIG_COUNTER_NRF_RTC

//  ========== prototypes ==================================================================
const struct device *app_rtc_init(void);
int8_t app_rtc_set_time(const struct device *rtc_dev, uint64_t target_time_ms);
int8_t  app_rtc_sync_uptime(const struct device *rtc_dev);
uint64_t app_rtc_get_time();
int8_t app_rtc_periodic_sync(const struct device *rtc_dev);

#endif /* APP_RTC_H */
```
